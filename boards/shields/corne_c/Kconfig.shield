## boards/shields/corne_c/Kconfig.shield
```kconfig
# No whitespace after the comma or in your keyboard name!
config SHIELD_CORNE_C_LEFT
    def_bool $(shields_list_contains,corne_c_left)

config SHIELD_CORNE_C_RIGHT
    def_bool $(shields_list_contains,corne_c_right)
```
